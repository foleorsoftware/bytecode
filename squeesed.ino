#include <EEPROM.h>
#define rsize 2
uint8_t ram[2];


// ============================================================
// VM MEMORY
// ============================================================



uint8_t pc = 0;
uint8_t a = 0;

// 0 = opcode
// 1 = PC low
// 2 = PC high
// 3 = opcode op foutlocatie
// 4 = register A



// ============================================================
// ERRORS IN FLASH
// ============================================================





// ============================================================
// PRINT ERROR
// ============================================================





// ============================================================
// EDIT MODE
// ============================================================

void edit() {

 

  Serial.println("opt+");
 


  for(uint8_t i = 0; i < EEPROM.length(); i++){
    while(!Serial.available()){

    }
    EEPROM.update(i, (byte)Serial.read());
  }
}


// ============================================================
// MAIN MENU
// ============================================================

void question1() {

  while (true) {

    
   
 
   

    // Wacht op een commando
    while (Serial.available() == 0) {
      delay(1);
    }

    char cmd = Serial.read();

    // Enter/line ending negeren
    if (cmd == '\r' || cmd == '\n') {
      continue;
    }

    // -------------------------
    // EDIT
    // -------------------------

    if (cmd == 'e') {

      // Eventuele newline verwijderen
      while (Serial.available()) {
        char c = Serial.peek();

        if (c == '\r' || c == '\n') {
          Serial.read();
        } else {
          break;
        }
      }

      edit();
    }

    // -------------------------
    // EXECUTION
    // -------------------------

    else if (cmd == 'x' || cmd == 'X') {

      while (Serial.available()) {
        Serial.read();
      }

      

      pc = 0;
      a = 0;

      

      while (true) {
        vm();
      }
    }

    // -------------------------
    // DEBUG
    // -------------------------

 

    // -------------------------
    // UNKNOWN
    // -------------------------

    else {

      

      while (Serial.available()) {
        Serial.read();
      }
    }
  }
}


// ============================================================
// VM
// ============================================================

bool vm() {

 
  pc = pc & EEPROM.length();

 

  switch (EEPROM.read(pc)) {

    // --------------------------------------------------------
    // 0 = PRINT CHARACTER
    // --------------------------------------------------------

    case 0:

      Serial.print((char)a);

      break;


    // --------------------------------------------------------
    // 1 = PRINT NUMBER
    // --------------------------------------------------------

    case 1:

      Serial.print(a);

      break;


    // --------------------------------------------------------
    // 2 = INPUT
    // --------------------------------------------------------

    case 2:

      if (Serial.available()) {
        a = Serial.read();
      }

      break;


    // --------------------------------------------------------
    // 3 = LOAD
    //
    // opcode
    // high byte
    // low byte
    // --------------------------------------------------------

    case 3:

   

      a = ram[EEPROM.read(pc + 1) & rsize -1];

      pc++;

      break;


    // --------------------------------------------------------
    // 4 = STORE
    //
    // opcode
    // high byte
    // low byte
    // --------------------------------------------------------

    case 4:

      

      ram[EEPROM.read(pc + 1)& rsize -1] = a ;

      pc += 1;

      break;


    // --------------------------------------------------------
    // 5 = ADD
    // --------------------------------------------------------

    case 5:

      a = a + EEPROM.read(pc + 1);

      pc++;

      break;


    // --------------------------------------------------------
    // 6 = SUB
    // --------------------------------------------------------

    case 6:

      a = a - EEPROM.read(pc + 1);

      pc++;

      break;


    // --------------------------------------------------------
    // 7 = INC
    // --------------------------------------------------------

    case 7:

      a++;

      break;


    // --------------------------------------------------------
    // 8 = DEC
    // --------------------------------------------------------

    case 8:

      a--;

      break;


    // --------------------------------------------------------
    // 9 = JEQ
    //
    // opcode
    // value
    // high byte
    // low byte
    // --------------------------------------------------------

    case 9:

      if (a == EEPROM.read(pc + 1)) {

        
        pc = EEPROM.read(pc + 2);

        // -1 zodat de pc++ onderaan
        // de juiste instructie uitvoert
        pc--;

      } else {

        pc += 2;
      }

      break;


    // --------------------------------------------------------
    // 10 = JMP
    //
    // opcode
    // high byte
    // low byte
    // --------------------------------------------------------

    case 10:

     

      pc = EEPROM.read(pc + 1);

      // pc++ gebeurt onderaan
      pc--;

      break;
     

          case 255:
          goto stop;
      break;

    // --------------------------------------------------------
    // UNKNOWN OPCODE
    // --------------------------------------------------------

    default:



      return false;
  }

  pc++;
stop:

while(1){

}
  return true;
}
void setup() {

 

  Serial.begin(115200);

  



  question1();
}


// ============================================================
// LOOP
// ============================================================

void loop() {

}